## qca/feeds/leedarson/device/Config.in
```kconfig
config DEVICE_WITH_SIREN_HUB
		depends on PACKAGE_device
		bool "add siren function"
		default y
 help
 	There is a siren function in SIRENHUB geteway, otherwise not
```

## qca/feeds/leedarson/lagent/Config.in
```kconfig
config LAGENT_CABLE
    bool "cable support"
    depends on PACKAGE_lagent
    default n
    help
        The device allows connecting the cloud via cable internet port.  
```

## qca/feeds/leedarson/ota/Config.in
```kconfig
#Ota model id configuration

choice
	prompt "Device Model ID Select"
	default OTA_A023_ENABLE
	
	config OTA_G151_ENABLE
		depends on PACKAGE_ota
		bool "LDS-G151 (The Home Depot - A023)"
		help 
			use a023 model a023.Siren_Hub.g151

	config OTA_G152_ENABLE
		depends on PACKAGE_ota
		bool "LDS-G152 (Own Siren Hub)"
		help 
			use a023 model a023.Siren_Hub.g151
		
	config OTA_G104_ENABLE
		depends on PACKAGE_ota
		bool "LDS-G104 (Education Gateway)"
		help 
			use edu model lds.gateway.g104

	config OTA_G402_ENABLE
		depends on PACKAGE_ota
		bool "LDS-G402 (Own Multi Protocol Gateway)"
		help 
			use edu model lds.gateway.g104	
endchoice
```

## qca/feeds/leedarson/subdevice/Config.in
```kconfig
#Subdevice configuration

choice
	prompt "Subdevice Branch Select"
	default SUBDEVICE_BRANCH_A023

	config SUBDEVICE_BRANCH_A023
		bool "Subdevice Branch A023"
		depends on PACKAGE_subdevice
		help 
			use subdevice branch a023
	
	config SUBDEVICE_BRANCH_MULTIPLE
		bool "Subdevice Branch Multiple Protocol"
		depends on PACKAGE_subdevice
		help 
			use subdevice branch multiple protocol	
		
	config SUBDEVICE_BRANCH_EDU
		bool "Subdevice Branch Education"
		depends on PACKAGE_subdevice
		help 
			use subdevice branch education		
			
endchoice

config SUBDEVICE_ZWAVE_ENABLE
	bool "Z-wave enable"
	depends on PACKAGE_subdevice
	default n
	help 
		use zwave module	


		
```

## qca/feeds/leedarson/zware/Config.in
```kconfig
#zware configuration

choice
	prompt "region"
	default ZWAVE_FW_US
		
	config ZWAVE_FW_EU
		depends on PACKAGE_zware
		bool "zwave firmware EU"
		help 
			use zwave firmware EU

	config ZWAVE_FW_US
		depends on PACKAGE_zware
		bool "zwave firmware US"
		help 
			use zwave firmware US	

	config ZWAVE_FW_CN
		depends on PACKAGE_zware
		bool "zwave firmware CN"
		help 
			use zwave firmware CN

	config ZWAVE_FW_HK
		depends on PACKAGE_zware
		bool "zwave firmware HK"
		help 
			use zwave firmware HK

	config ZWAVE_FW_ANZ
		depends on PACKAGE_zware
		bool "zwave firmware ANZ"
		help 
			use zwave firmware ANZ

	config ZWAVE_FW_JP
		depends on PACKAGE_zware
		bool "zwave firmware JP"
		help 
			use zwave firmware JP
			
	config ZWAVE_FW_RU
		depends on PACKAGE_zware
		bool "zwave firmware RU"
		help 
			use zwave firmware RU

	config ZWAVE_FW_IL
		depends on PACKAGE_zware
		bool "zwave firmware IL"
		help 
			use zwave firmware IL

	config ZWAVE_FW_IN
		depends on PACKAGE_zware
		bool "zwave firmware IN"
		help 
			use zwave firmware IN

	config ZWAVE_FW_KR
		depends on PACKAGE_zware
		bool "zwave firmware KR"
		help 
			use zwave firmware KR
	
endchoice
```
